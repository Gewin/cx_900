#include "iom128.h"
#include "ina90.h"

#include"LCD_240160.h"

uint  p_add_dis_chu=0xfcff; 
/***************************************************
函数：void delay(uint t)
功能：延时毫秒级
******************************************************/
void delay(unsigned volatile int t)
{
	while(t--);
}
void eeprom_write(unsigned int add,uchar data)
{
	uchar eewe;
	eewe=0x02;
	for(;eewe==0x02;) 
	eewe=EECR&0x02;  
	EEARH=(uchar)(add>>8);
	EEARL=(uchar)add;
	EEDR=data;  
	EECR=0x04;
	EECR=EECR|0x02; 
}
uchar eeprom_read(unsigned int add)
{
    uchar data,eewe=0x02;
    for (;eewe==0x02;) 
      eewe=EECR&0x02; 
    EEARH=(uchar)(add>>8); 
    EEARL=(uchar)add;
    EECR=0x01; 
    data=EEDR;
    return data;
}

/**************************************************
函数：void lcd_cmdwrite (uchar cmdx , uchar cmdy)
功能：在指定的寄存器写下命令
********************************************************/
void lcd_cmdwrite (uchar cmdx , uchar cmdy)
{
	uchar *p;
	p_add_dis_chu=p_add_dis_chu&0xfcff;
	p=(uchar *)p_add_dis_chu; 
	*p=cmdx;
	p_add_dis_chu=0xffff;
	p_add_dis_chu=p_add_dis_chu&0xfcff;
	p=(uchar *)p_add_dis_chu; 
	*p=cmdy;
	p_add_dis_chu=0xffff;
}
/*************************************************
函数：void lcd_datawrite(uchar datax)
功能：写下显示的数据
*****************************************************/
void lcd_datawrite(uchar datax)
{
	uchar *p;
	p_add_dis_chu=p_add_dis_chu&0xfcff|0x0200;
	p=(uchar *)p_add_dis_chu; 
	*p=datax;
	p_add_dis_chu=0xfdff;
}
/********************************************************
函数：void lcd_init()
功能：初始化好多函数
********************************************************/
void lcd_init(void)
{
	lcd_cmdwrite(0x00,0xCd);//WLCR,
	lcd_cmdwrite(0x01,0xf2);//MISC
	lcd_cmdwrite(0x02,0x10);//APSR
	lcd_cmdwrite(0x03,0x80);//ADSR
	lcd_cmdwrite(0x10,0x2b);//WCCR//0x2b正常字体，0x3b黑体
	lcd_cmdwrite(0x11,0x22);//CHLD
	lcd_cmdwrite(0x12,0x91);//MAMR
	lcd_cmdwrite(0x20,  29);//AWRR 宽
	lcd_cmdwrite(0x30, 0x9f);//AWBR 高//127
	lcd_cmdwrite(0x40,0x00);
	lcd_cmdwrite(0x50,0x00);
	lcd_cmdwrite(0x21,  29);//宽	
	lcd_cmdwrite(0x31, 0x9f);//高//127
	lcd_cmdwrite(0x41,0x00);
	lcd_cmdwrite(0x51,0x00);
	lcd_cmdwrite(0x60,0x00);
	lcd_cmdwrite(0x61,0x00);
	lcd_cmdwrite(0x70,0x00);
	lcd_cmdwrite(0x71,0x00);
	lcd_cmdwrite(0x72,0x9F);
	lcd_cmdwrite(0x80,0x33);
	lcd_cmdwrite(0x81,0x00);
	lcd_cmdwrite(0x91,0x00);
	lcd_cmdwrite(0x90,0x0C);
	lcd_cmdwrite(0xA0,0x11);
	lcd_cmdwrite(0xA1,0x00);
	lcd_cmdwrite(0xA2,0x00);
	lcd_cmdwrite(0xA3,0x00);
	lcd_cmdwrite(0xB0,0x1d);
	lcd_cmdwrite(0xB1,0x9f);
	lcd_cmdwrite(0xC0,0x00);
	lcd_cmdwrite(0xC1,0x0A);
	lcd_cmdwrite(0xC8,0x80);
	lcd_cmdwrite(0xC9,0x80);
	lcd_cmdwrite(0xCA,0x00);
	lcd_cmdwrite(0xD0,0x16);
	lcd_cmdwrite(0xE0,0x00);
	lcd_cmdwrite(0xF0,0xA0);
	lcd_cmdwrite(0xF1,0x0F);
}
/***********************************************
函数：void display_hz(uchar *text，uchar x,y)
功能：在指定的地方显示字符，汉字
******************************************************/
void display_hz(uchar __flash *text,uchar x,uchar y,uchar count)
{ ///x:0-30 y:0-160 
	uchar i;
	lcd_cmdwrite(0x00,0xcd); //汉字模式
	lcd_cmdwrite(0x60,x);
	lcd_cmdwrite(0x70,y);
	for(i=0;i<count;i++)
	{
		lcd_datawrite(*text);
		++text;  
	}
}
/*******************************************
函数：void display_img(uchar code *p)
功能：显示一幅图像
*********************************************/
void display_img(uchar col,uchar row,uchar __flash *p,uchar c,uchar width,uchar high)
{//width=实际宽度/8
	uchar i,j;
	uint s=0;
	lcd_cmdwrite(0x00,0xc5);
	for(i=0;i<high;i++)  //
	{
		lcd_cmdwrite(0x00,0xc5);
		lcd_cmdwrite(0x60,col);//列
		lcd_cmdwrite(0x70,row++); //行 //设置起始点
		for(j=0;j<width;j++)  //24064是30,160128是20
		{    
	 		if(c==1)
	 		{
				lcd_datawrite(p[s++]);
	  		}
	  		else if(c==0)
	  		{//反白
				lcd_datawrite(~p[s++]);			
	  		}
	  		else if(c==0xff)
	  		{//清屏
				lcd_datawrite(0);
	  		}
		}	
	}     
}

void display_wdian(uchar s,uchar n)
{
	uchar i,j;
	lcd_cmdwrite(0x00,0xc5);
	for(i=0;i<160/n;i++)
	{
		for(j=0;j<30;j++)
		{
			lcd_datawrite(s);
			if(n==2)
				lcd_datawrite(s);
			if(n==4)
			{
				lcd_datawrite(s);
				lcd_datawrite(s);
				lcd_datawrite(s);
			}
		}
		s=~s;
	}
}

/*****************************************************
函数：void lcd_clear()
功能：清除内存
********************************************************/
void lcd_clear(void)
{
	display_img(0,0,main_interface1,0xff,30,160);
}

uchar __flash main_interface1[]={0xFF,0xFF,0xFF,0xFF,0xFF,0xFF,0xFF,0xFF,0xFF,0xFF,0xFF,0xFF,0xFF,0xFF,0xFF,0xFF,
0xFF,0xFF,0xFF,0xFF,0xFF,0xFF,0xFF,0xFF,0xFF,0xFF,0xFF,0xFF,0xFF,0xFF,0x80,0x00,
0x00,0x00,0x00,0x00,0x00,0x00,0x00,0x00,0x04,0x00,0x00,0x00,0x00,0x00,0x00,0x00,
0x00,0x00,0x00,0x00,0x00,0x00,0x04,0x00,0x00,0x00,0x00,0x01,0x80,0x00,0x00,0x00,
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0xFF,0xFF,0xFF,0xFF,0xFF,0xFF,0xFF,0xFF,0xFF,0xFF,0xFF,0xFF,0xFF,0xFF,0xFF,0xFF};
uchar __flash chars_F[]={"F:EdBmnmMHz"};
uchar __flash chars_freq[]={"F: 467.700MHz"};
uchar __flash chars_1310nm[]={"1310nm"};
uchar __flash chars_1550nm[]={"1550nm"};
uchar __flash chars_dBm[]={"- 21 dBm"};

uchar __flash space[]={"                  "};
uchar __flash dot[]={"."};
uchar __flash chars_MHz[]={"MHz"};
uchar __flash chars_NPdBm[]={"-+dBmW"};

uchar __flash Mode1[]={"J--X"};
uchar __flash Mode2[]={"J--S"};
uchar __flash Mode3[]={"Y--X"};
uchar __flash Mode4[]={"Y--S"};
uchar __flash Mode5[]={"Z--J"};

uchar __flash battery[5][48]={
								{0x01,0xFF,0xF8,0x00,0x00,0x00,0x01,0xFF,0xF8,0x00,0x00,0x00,0x01,0xFF,0xFF,0x80,
								 0x00,0x00,0x01,0xFF,0xFF,0x80,0x00,0x00,0x01,0xFF,0xFF,0x80,0x00,0x00,0x01,0xFF,
								 0xFF,0x80,0x00,0x00,0x01,0xFF,0xF8,0x00,0x00,0x00,0x01,0xFF,0xF8,0x00,0x00,0x00},
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								{0x00,0x00,0x00,0x00,0x00,0x00,0x00,0x00,0x00,0x00,0x00,0x00,0x00,0x00,0x00,0x00,
								 0x00,0x00,0x00,0x00,0x00,0x00,0x00,0x00,0x00,0x00,0x00,0x00,0x00,0x00,0x00,0x00,
								 0x00,0x00,0x00,0x00,0x00,0x00,0x00,0x00,0x00,0x00,0x00,0x00,0x00,0x00,0x00,0x00}
							};

uchar __flash E[]={0x00,0x00,0x00,0x00,0x00,0x00,0x00,0x00,0x00,0x00,0x00,0x00,0x00,0x01,0xFE,0x00,
				0x00,0x00,0x00,0x00,0x00,0x00,0x00,0x00,0xC6,0x00,0x00,0x00,0x00,0x00,0x00,0x00,
				0x00,0x00,0xC3,0x00,0x00,0x00,0x00,0x00,0x00,0x00,0x00,0x00,0xCC,0x00,0x00,0x00,
				0x00,0x00,0x00,0x00,0x00,0x00,0xCC,0x00,0x00,0x00,0x00,0x00,0x00,0x00,0x00,0x00,
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				0x00,0x00,0x00,0x00,0x00,0x00,0x00,0x00,0x00,0x00,0x00,0x00,0x00,0x00,0x00,0x00};

uchar __flash key[]={"0123456789ABCDEFGHIJKLMN"};
uchar __flash key1[17][32]={
								 {0x00,0x00,0x07,0xC0,0x0C,0x60,0x0C,0x60,0x18,0x30,0x18,0x30,0x18,0x30,0x18,0x30,      //0
								  0x18,0x30,0x18,0x30,0x18,0x30,0x0C,0x60,0x0C,0x60,0x07,0xC0,0x00,0x00,0x00,0x00}, 
								 {0x00,0x00,0x01,0x80,0x07,0x80,0x01,0x80,0x01,0x80,0x01,0x80,0x01,0x80,0x01,0x80,
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0x0F,0xF0,0x0F,0xF0,0x07,0xE0,0x07,0xE0,0x06,0x60,0x06,0x60,0x06,0x60,0x00,0x00}
								 
                             };

void display_freq(void)
{  
	//uchar bit1,bit2,bit3,bit4;
	
	//bit1=eeprom_read(0x21);
	//bit2=eeprom_read(0x22);
	//bit3=eeprom_read(0x23);
	//bit4=eeprom_read(0x24);
	display_hz(&chars_F[0],12,1,2);
	display_hz(&key[9],14,1,1);
	display_hz(&key[3],15,1,1);
	display_hz(&key[2],16,1,1);
	display_hz(&dot[0],17,1,1);
	display_hz(&key[0],18,1,1);
	display_hz(&key[0],19,1,1);
	display_hz(&key[0],20,1,1);
	display_hz(&chars_MHz[0],21,1,3);
	//display_hz(&key[0],25,1,1);
	//switch(bit4)
	//{
	//case 0:
		//display_hz(&key[0],23,1,1);
		//display_hz(&key[0],24,1,1);
		/*break;
	case 2:
		display_hz(&key[2],23,1,1);
		display_hz(&key[5],24,1,1);
		break;
	case 5:
		display_hz(&key[5],23,1,1);
		display_hz(&key[0],24,1,1);
		break;
	case 7:
		display_hz(&key[7],23,1,1);
		display_hz(&key[5],24,1,1);
		break;
	default:
		break;  
	}*/
	
}
void display1_freq(void)
{  
	//uchar bit1,bit2,bit3,bit4;
	
	//bit1=eeprom_read(0x21);
	//bit2=eeprom_read(0x22);
	//bit3=eeprom_read(0x23);
	//bit4=eeprom_read(0x24);
	display_hz(&chars_F[0],12,1,2);
	display_hz(&key[8],14,1,1);
	display_hz(&key[8],15,1,1);
	display_hz(&key[7],16,1,1);
	display_hz(&dot[0],17,1,1);
	display_hz(&key[0],18,1,1);
	display_hz(&key[0],19,1,1);
	display_hz(&key[0],20,1,1);
	display_hz(&chars_MHz[0],21,1,3);
}
